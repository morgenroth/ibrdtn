## recipes/buildroot/dtndht/Config.in
```kconfig
config BR2_PACKAGE_DTNDHT
	bool "dtndht"
	select BR2_PACKAGE_OPENSSL
	help
	  Library to query and register to a DTN DHT.
```

## recipes/buildroot/ibrcommon/Config.in
```kconfig
config BR2_PACKAGE_IBRCOMMON
	bool "ibrcommon"
	depends on BR2_INSTALL_LIBSTDCPP && BR2_INET_IPV6 && BR2_LARGEFILE
	select BR2_PACKAGE_LIBNL
	select BR2_PACKAGE_OPENSSL
	help
	  IBR common library

	  http://www.ibr.cs.tu-bs.de/projects/ibr-dtn/
```

## recipes/buildroot/ibrdtn-tools/Config.in
```kconfig
config BR2_PACKAGE_IBRDTN_TOOLS
	bool "ibrdtn-tools"
	select BR2_PACKAGE_LIBTFFS
	select BR2_PACKAGE_LIBARCHIVE
	select BR2_PACKAGE_IBRCOMMON
	select BR2_PACKAGE_IBRDTN
	help
	  IBR-DTN Tools

	  http://www.ibr.cs.tu-bs.de/projects/ibr-dtn/
```

## recipes/buildroot/ibrdtn/Config.in
```kconfig
config BR2_PACKAGE_IBRDTN
	bool "ibrdtn"
	select BR2_PACKAGE_OPENSSL
	select BR2_PACKAGE_ZLIB
	select BR2_PACKAGE_IBRCOMMON
	help
	  IBR-DTN Base Library

	  http://www.ibr.cs.tu-bs.de/projects/ibr-dtn/
```

## recipes/buildroot/ibrdtnd/Config.in
```kconfig
config BR2_PACKAGE_IBRDTND
	bool "ibrdtnd"
	select BR2_PACKAGE_DTNDHT
	select BR2_PACKAGE_ZLIB
	select BR2_PACKAGE_OPENSSL
	select BR2_PACKAGE_SQLITE
	select BR2_PACKAGE_IBRCOMMON
	select BR2_PACKAGE_IBRDTN
	help
	  IBR-DTN Daemon

	  http://www.ibr.cs.tu-bs.de/projects/ibr-dtn/
```

## recipes/buildroot/libtffs/Config.in
```kconfig
config BR2_PACKAGE_LIBTFFS
	bool "libtffs"
	help
	  tffs-lib is a Tiny FAT File System library.

config BR2_PACKAGE_LIBTFFS_TSH
        bool "libtffs tool tsh"
        depends on BR2_PACKAGE_LIBTFFS
        select BR2_PACKAGE_NCURSES
        help
          tiny shell tool for tffs library
```

## recipes/libtffs-tshell/Config.in
```kconfig
config BR2_PACKAGE_LIBTFFS_TSHELL
	bool "libtffs-tshell"
	help
	  tiny shell tool for tffs library
```

## recipes/libtffs/Config.in
```kconfig
config BR2_PACKAGE_LIBTFFS
  bool "libtffs"
  help
    tffs-lib is a Tiny FAT File System library.
```
